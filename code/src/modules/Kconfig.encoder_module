## code/src/modules/Kconfig.encoder_module
```kconfig
menuconfig ENCODER_MODULE
	bool "Module dealing with encoder data"
	default y
	depends on QDEC_GPIO

if ENCODER_MODULE

config ENCODER_MAX_MESSAGE_FREQUENCY
	int "Maximum amount of messages allowed to be sent per second"
	default 200

config ENCODER_MINIMUM_DELTA_TIME_MSEC
	int "Minimum milliseconds required for a encoder update to be valid"
	default 10
	help
		"Larger values means there is less susceptibility 
		to noise but the system might not pick up actual readings"
endif # ENCODER_MODULE

module = ENCODER_MODULE
module-str = Encoder module
source "subsys/logging/Kconfig.template.log_config"
```

## code/src/modules/Kconfig.motor_module
```kconfig
#
# Copyright (c) 2021 Nordic Semiconductor
#
# SPDX-License-Identifier: LicenseRef-Nordic-5-Clause
#

menuconfig MOTOR_MODULE
	bool "Motor module"
	default y

if MOTOR_MODULE

config MOTOR_THREAD_STACK_SIZE
	int "Motor module thread stack size"
	default 1280

config MOTOR_MODULE_MIN_PERIOD_MSEC
	int "Minimum period the user may set for oscillations"
	default 200

config MOTOR_MODULE_MAX_PERIOD_MSEC
	int "Minimum period the user may set for oscillations"
	default 3000

config MOTOR_MODULE_AMPLITUDE_STEP
	int "Number of steps per encoder tick the amplitude increases/decreases by"
	default 10

config MOTOR_MODULE_PERIOD_STEP
	int "Number of steps per encoder tick the period increases/decreases by"
	default 10

config MOTOR_MODULE_USE_BTN_INPUT
	depends on CAF_BUTTON_EVENTS
	bool "Use 4 buttons in place of 2 encoders"
	default n


endif # MOTOR_MODULE

module = MOTOR_MODULE
module-str = Motor module
source "subsys/logging/Kconfig.template.log_config"
```

## project/src/modules/Kconfig.motor_module
```kconfig
#
# Copyright (c) 2021 Nordic Semiconductor
#
# SPDX-License-Identifier: LicenseRef-Nordic-5-Clause
#

menuconfig MOTOR_MODULE
	bool "Motor module"
	default y

if MOTOR_MODULE

config MOTOR_THREAD_STACK_SIZE
	int "Motor module thread stack size"
	default 1280


endif # MOTOR_MODULE

module = MOTOR_MODULE
module-str = Motor module
source "subsys/logging/Kconfig.template.log_config"
```

## src/modules/Kconfig.motor_module
```kconfig
#
# Copyright (c) 2021 Nordic Semiconductor
#
# SPDX-License-Identifier: LicenseRef-Nordic-5-Clause
#

menuconfig MOTOR_MODULE
	bool "MOTOR module"
	default y

if MOTOR_MODULE

config MOTOR_THREAD_STACK_SIZE
	int "MOTOR module thread stack size"
	default 1280


endif # MOTOR_MODULE

module = MOTOR_MODULE
module-str = MOTOR module
source "subsys/logging/Kconfig.template.log_config"
```

/* SPDX-License-Identifier: Apache-2.0 */

/ {
	servo: servo {
		compatible = "pwm-servo";
        status="okay";
		pwms = <&pwm0 0 PWM_MSEC(20) PWM_POLARITY_NORMAL>;
		min-pulse = <PWM_USEC(1500)>;
		max-pulse = <PWM_USEC(2500)>;
	};


};
&led0 {
    status = "disabled";
};

&pwm_led0 {
    status="disabled";
};